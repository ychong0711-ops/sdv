## CMakeLists.txt
```
cmake_minimum_required(VERSION 3.20.0)
find_package(Zephyr REQUIRED HINTS $ENV{ZEPHYR_BASE})
project(sdv_mcu)

target_sources(app PRIVATE
    src/main.cpp
    src/can_gateway.cpp
    src/someip_service.cpp
    src/someip_sd.cpp
    src/safety.cpp
)

zephyr_include_directories(src)
```

## Kconfig
```
# 앱 Kconfig 루트 — 반드시 Zephyr Kconfig 트리를 source해야 함
# (앱에 자체 Kconfig가 있으면 이 파일이 트리 루트가 되어, 없으면
#  SERIAL/LOG/CAN 등 모든 Zephyr 심볼이 "undefined"로 빌드 실패)
source "$(ZEPHYR_BASE)/Kconfig"

menuconfig SOMEIP
	bool "SOME/IP options"
	default y

if SOMEIP

config SOMEIP_TRANSPORT_UART
	bool "SOME/IP transport over UART (lpuart1, real board)"
	default n
	help
	  실보드(UNO Q)에서는 MPU-MCU 물리 링크가 LPUART1이므로 UART 터널 사용.
	  PC 시뮬레이션에서는 UDP(127.0.0.1:30490) 사용 (기본).
	  UART 사용 시 DT_ALIAS(someip-uart)로 지정된 LPUART1 장치가 필요하다.

endif # SOMEIP
```

## prj.conf
```kconfig
# Zephyr prj.conf - STM32U585 SDV Zone Controller
CONFIG_LOG=y
CONFIG_LOG_PRINTK=y
CONFIG_LOG_DEFAULT_LEVEL=3

# SOME/IP transport:
#   - 기본값: UDP (PC 시뮬레이션, 127.0.0.1:30490)
#   - 실보드(UNO Q): CONFIG_SOMEIP_TRANSPORT_UART=y (LPUART1 터널)
#   - 기본값은 Kconfig(MCU/Kconfig)에서 n으로 정의됨
# CONFIG_SOMEIP_TRANSPORT_UART=n

# CAN-FD
CONFIG_CAN=y
CONFIG_CAN_FD_MODE=y
# 참고: 필터 수는 최신 Zephyr에서 런타임 API can_get_max_filters()로 조회
# (과거 CONFIG_CAN_MAX_FILTER는 Zephyr main에서 제거됨)

# Networking (SOME/IP over UDP)
CONFIG_NETWORKING=y
CONFIG_NET_UDP=y
CONFIG_NET_SOCKETS=y
CONFIG_NET_SOCKETS_SOCKOPT_TLS=n
CONFIG_NET_IPV4=y
CONFIG_NET_DHCPV4=n
CONFIG_NET_CONFIG_SETTINGS=y
# SD(Service Discovery) multicast receive: OfferService 수신을 위해 IGMP 그룹 가입 필요
CONFIG_NET_IPV4_IGMP=y

# Watchdog
CONFIG_WATCHDOG=y

# GPIO
CONFIG_GPIO=y

# Thread
CONFIG_MAIN_STACK_SIZE=2048
```

## boards/arduino_uno_q.overlay
```dts
/*
 * Arduino UNO Q (STM32U585) 앱 오버레이
 *
 * - CAN: on-SoC FDCAN1을 zephyr,canbus로 노출 (보드 기본 DTS에는 없음).
 *   주의: STM32U585의 FDCAN 핀 mux는 실보드 하드웨어 확인 필요.
 *   (UNO Q에 CAN 트랜시버가 노출되지 않으면 MCP2517FD(SPI) 드라이버로 전환 검토)
 * - SOME/IP UART 터널: lpuart1 (보드에서 QRB2210 MPU로 연결된 UART, 115200)
 */
/ {
    chosen {
        zephyr,canbus = &fdcan1;
    };

    aliases {
        someip-uart = &lpuart1;
    };
};

&fdcan1 {
    status = "okay";
};
```

## src/main.cpp
```c
/**
 * MCU: STM32U585 (Cortex-M33) + Zephyr RTOS
 * Heterogeneous SDV Zone Controller - Real-Time Core
 * 
 * Rebranded: Arduino UNO Q MCU side, but NO Arduino abstraction used.
 * Build: west build -b arduino_uno_q ./MCU
 * 
 * Features:
 *  - Zephyr RTOS (threads, timers, watchdog)
 *  - SOME/IP light stack (raw-socket 경량 구현)
 *  - CAN-FD TX with E2E CRC8 (ISO 26262)
 *  - Safe State on MPU heartbeat timeout
 */

#include <zephyr/kernel.h>
#include <zephyr/drivers/can.h>
#include <zephyr/drivers/gpio.h>
#include <zephyr/logging/log.h>

#include "can_gateway.h"
#include "someip_service.h"
#include "safety.h"

LOG_MODULE_REGISTER(mcu_main, LOG_LEVEL_INF);

#define CAN_DEVICE_NODE DT_CHOSEN(zephyr_canbus)
static const struct device *can_dev = DEVICE_DT_GET(CAN_DEVICE_NODE);
static const struct gpio_dt_spec led = GPIO_DT_SPEC_GET(DT_ALIAS(led0), gpios);

// SOME/IP Events (공통 상수)
#define EVENT_NOTIFY 0x8001
#define EVENT_HEARTBEAT 0x8002

// Zephyr Threads: CAN, SOME/IP, Safety 각각 분리 (Freedom from Interference)
#define STACK_SIZE 2048
K_THREAD_STACK_DEFINE(can_stack, STACK_SIZE);
K_THREAD_STACK_DEFINE(someip_stack, STACK_SIZE);
static struct k_thread can_thread_data;
static struct k_thread someip_thread_data;

// Shared: MPU에서 받은 졸음 레벨 (0-100)
static atomic_t drowsiness_level = ATOMIC_INIT(0);
static atomic_t mpu_heartbeat = ATOMIC_INIT(0);

void can_thread(void *, void *, void *) {
    LOG_INF("CAN thread started (Prio 5)");
    while (1) {
        int level = atomic_get(&drowsiness_level);
        if (level > 0) {
            // CAN-FD 프레임: ID 0x18FF01F4 (J1939 확장), DLC 8
            // Data: [0x55, 0xAA, 0x01, level, 0x00, 0x00, CRC, counter]
            can_send_drowsiness(can_dev, (uint8_t)level);
            atomic_set(&drowsiness_level, 0);
        }
        k_msleep(10); // 10ms 주기 - Real-Time
    }
}

void someip_thread(void *, void *, void *) {
    LOG_INF("SOME/IP thread started (Prio 6)");
    someip_init(); // Offer Service 0x1234/0x5678
    someip_offer_service();

    uint32_t last_find = 0;
    while (1) {
        // SD 클라이언트: 2초마다 FindService 재전송 (프로바이더 재시작 대응)
        if (k_uptime_get_32() - last_find >= 2000) {
            someip_sd_send_find();
            last_find = k_uptime_get_32();
        }

        // SOME/IP 수신 대기 (blocking): Notify(0x8001) / Heartbeat(0x8002) 공통 진입점
        uint16_t event_id;
        uint8_t payload;
        if (someip_receive(&event_id, &payload) == 0) {
            atomic_set(&mpu_heartbeat, k_uptime_get_32());
            if (event_id == EVENT_NOTIFY) {
                atomic_set(&drowsiness_level, payload);
                LOG_INF("SOME/IP RX: drowsiness=%u%%", payload);
            }
            // EVENT_HEARTBEAT(0x8002): heartbeat 전용 (추가 처리 없음)
            safety_kick_watchdog(); // notify/heartbeat 수신 시 safety 상태 유지
        }
    }
}

int main(void) {
    LOG_INF("=== SDV Zone Controller (STM32U585 + Zephyr) Boot ===");
    LOG_INF("Build: %s %s", __DATE__, __TIME__);

    // 1. GPIO (LED for Safe State)
    if (!gpio_is_ready_dt(&led)) {
        LOG_ERR("LED GPIO not ready");
        return 0;
    }
    gpio_pin_configure_dt(&led, GPIO_OUTPUT_ACTIVE);

    // 2. CAN-FD 초기화 (500k arbit, 2M data)
    if (!device_is_ready(can_dev)) {
        LOG_ERR("CAN device not ready");
        return 0;
    }
    struct can_timing timing;
    struct can_timing timing_data;
    // arbitration 500k (75% sample point) / data 2M (87.5%) — CAN-FD dual timing
    if (can_calc_timing(can_dev, &timing, 500000, 750) != 0 ||
        can_set_timing(can_dev, &timing) != 0) {
        LOG_ERR("CAN arbitration timing config failed");
        return 0;
    }
    if (can_calc_timing_data(can_dev, &timing_data, 2000000, 875) != 0 ||
        can_set_timing_data(can_dev, &timing_data) != 0) {
        LOG_ERR("CAN data timing config failed");
        return 0;
    }
    can_set_mode(can_dev, CAN_MODE_NORMAL);
    can_start(can_dev);
    LOG_INF("CAN-FD started: 500k/2M");

    // 3. Safety (Watchdog 100ms) - CAN + LED 참조 전달
    safety_init(can_dev, &led);

    // 4. Threads 생성 (Zephyr RTOS)
    k_thread_create(&can_thread_data, can_stack, K_THREAD_STACK_SIZEOF(can_stack),
                    can_thread, NULL, NULL, NULL, 5, 0, K_NO_WAIT);
    k_thread_create(&someip_thread_data, someip_stack, K_THREAD_STACK_SIZEOF(someip_stack),
                    someip_thread, NULL, NULL, NULL, 6, 0, K_NO_WAIT);

    // 5. Main loop: LED heartbeat + watchdog
    //    NORMAL에서만 500ms LED 토글. SAFE 중 LED는 safety가 소유 (100ms 빠른 점멸).
    while (1) {
        if (!safety_is_safe_state()) {
            gpio_pin_toggle_dt(&led);
            k_msleep(500);
        } else {
            k_msleep(100); // SAFE 중에는 LED 토글하지 않고 safety 타이머 콜백에 위임
        }
        // Watchdog은 someip_thread에서 kick, 여기서는 Safety 타이머가 감시
    }
    return 0;
}
```

## src/can_gateway.cpp
```c
#include "can_gateway.h"
#include <zephyr/logging/log.h>
LOG_MODULE_REGISTER(can_gw, LOG_LEVEL_DBG);

static uint8_t alive_counter = 0;

uint8_t e2e_crc8(const uint8_t *data, size_t len) {
    uint8_t crc = 0xFF;
    for (size_t i = 0; i < len; i++) {
        crc ^= data[i];
        for (int b = 0; b < 8; b++) {
            if (crc & 0x80) crc = (crc << 1) ^ 0x1D;
            else crc <<= 1;
        }
    }
    return crc ^ 0xFF;
}

// 공통 CAN-FD 프레임 전송: [0x55][0xAA][0x01][level][0x00][0x00][CRC][Counter]
static int can_send_frame(const struct device *can_dev, uint8_t level, int32_t timeout_ms) {
    struct can_frame frame = {0};
    frame.id = 0x18FF01F4;
    frame.flags = CAN_FRAME_IDE | CAN_FRAME_FDF | CAN_FRAME_BRS; // Extended + CAN-FD + BRS
    frame.dlc = 8;
    // Data: [Header 0x55][Header 0xAA][Version 0x01][Level][Reserved][Reserved][CRC][Counter]
    frame.data[0] = 0x55;
    frame.data[1] = 0xAA;
    frame.data[2] = 0x01;
    frame.data[3] = level;
    frame.data[4] = 0x00;
    frame.data[5] = 0x00;
    frame.data[6] = e2e_crc8(frame.data, 6); // E2E Protection
    frame.data[7] = alive_counter++;

    int ret = can_send(can_dev, &frame, K_MSEC(timeout_ms), NULL, NULL);
    if (ret == 0) {
        LOG_INF("CAN TX: ID 0x%08X DLC %d Data %02X %02X %02X %02X CRC %02X Ctr %02X",
                frame.id, frame.dlc,
                frame.data[0], frame.data[1], frame.data[2], frame.data[3],
                frame.data[6], frame.data[7]);
    } else {
        LOG_ERR("CAN TX failed: %d", ret);
    }
    return ret;
}

int can_send_drowsiness(const struct device *can_dev, uint8_t level) {
    // CAN thread 컨텍스트 - 100ms 타임아웃 유지
    return can_send_frame(can_dev, level, 100);
}

int can_send_warning(const struct device *can_dev) {
    // safety 타이머 콜백(workqueue)에서 호출되므로 K_MSEC(5) 이하 타임아웃 사용
    return can_send_frame(can_dev, 0xFF, 5);
}
```

## src/can_gateway.h
```c
#pragma once
#include <zephyr/drivers/can.h>
#include <stdint.h>

// CAN-FD: Drowsiness 경고 프레임
// ID: 0x18FF01F4 (J1939 Proprietary A, Priority 6)
// DLC: 8, E2E Protection: CRC8 SAE J1850 + Alive Counter
int can_send_drowsiness(const struct device *can_dev, uint8_t level);

// CAN-FD: Safe-State 경고 프레임 (level=0xFF, 데이터 레이아웃 동일, CRC/카운터 포함)
int can_send_warning(const struct device *can_dev);

// E2E CRC8 (SAE J1850, poly 0x1D) - ISO 26262 E2E Profile 1
uint8_t e2e_crc8(const uint8_t *data, size_t len);
```

## src/safety.cpp
```c
#include "safety.h"
#include "can_gateway.h"
#include <zephyr/kernel.h>
#include <zephyr/drivers/watchdog.h>
#include <zephyr/drivers/gpio.h>
#include <zephyr/logging/log.h>
LOG_MODULE_REGISTER(safety, LOG_LEVEL_INF);

#define WDT_NODE DT_ALIAS(watchdog0)
static const struct device *wdt = DEVICE_DT_GET(WDT_NODE);
static struct k_timer safety_timer;

#define HEARTBEAT_TIMEOUT_MS 100
#define WDT_TIMEOUT_MS 150

// 상태 머신: NORMAL / SAFE
static bool safe_state = false; // false = NORMAL, true = SAFE
static const struct device *safety_can_dev = NULL;
static const struct gpio_dt_spec *safety_led = NULL;

// ISO 26262 Safe State 진입: SAFE 전환 + CAN 경고 1회 + LED 토글 시작
static void enter_safe_state(void) {
    if (safe_state) return; // 이미 SAFE면 재진입 없음
    LOG_WRN("=== SAFE STATE ENTERED ===");
    safe_state = true;
    if (safety_can_dev) can_send_warning(safety_can_dev); // CAN 경고 프레임 (level=0xFF)
    if (safety_led) gpio_pin_toggle_dt(safety_led);       // LED 빠른 점멸 시작
}

static void safety_timeout(struct k_timer *timer) {
    ARG_UNUSED(timer);
    if (!safe_state) {
        // NORMAL: MPU heartbeat 타임아웃 -> SAFE 진입
        enter_safe_state();
    } else {
        // SAFE: 안전 동작 반복 (CAN 경고 + LED 토글 + WDT feed - 의도적 유지, 리셋 금지)
        // 주의: 타이머 콜백은 system workqueue 컨텍스트 -> k_sleep/k_msleep 금지.
        // can_send는 K_MSEC(5) 이하 타임아웃 사용.
        if (safety_can_dev) can_send_warning(safety_can_dev);
        if (safety_led) gpio_pin_toggle_dt(safety_led);
        if (device_is_ready(wdt)) wdt_feed(wdt, 0);
    }
}

void safety_init(const struct device *can_dev, const struct gpio_dt_spec *led) {
    safety_can_dev = can_dev;
    safety_led = led;

    // 1. Hardware Watchdog (STM32 IWDG)
    if (device_is_ready(wdt)) {
        struct wdt_timeout_cfg cfg = {
            .window = {0, WDT_TIMEOUT_MS},
            .callback = nullptr,
            .flags = WDT_FLAG_RESET_SOC
        };
        wdt_install_timeout(wdt, &cfg);
        wdt_setup(wdt, WDT_OPT_PAUSE_HALTED_BY_DBG);
        LOG_INF("Watchdog: %dms (IWDG)", WDT_TIMEOUT_MS);
    } else {
        LOG_WRN("Watchdog not ready, using software timer only");
    }

    // 2. Safety Timer (MPU heartbeat monitor)
    k_timer_init(&safety_timer, safety_timeout, nullptr);
    k_timer_start(&safety_timer, K_MSEC(HEARTBEAT_TIMEOUT_MS), K_MSEC(HEARTBEAT_TIMEOUT_MS));
    LOG_INF("Safety timer: %dms heartbeat timeout", HEARTBEAT_TIMEOUT_MS);
}

void safety_kick_watchdog(void) {
    if (device_is_ready(wdt)) wdt_feed(wdt, 0);
    k_timer_start(&safety_timer, K_MSEC(HEARTBEAT_TIMEOUT_MS), K_MSEC(HEARTBEAT_TIMEOUT_MS));
    // heartbeat 복구 시 SAFE -> NORMAL 복귀
    if (safe_state) {
        LOG_INF("Heartbeat recovered -> NORMAL state");
        safe_state = false;
    }
}

bool safety_is_safe_state(void) {
    return safe_state;
}
```

## src/safety.h
```c
#pragma once
// ISO 26262 Safe State + Watchdog (ASIL-B)
#include <stdbool.h>
#include <zephyr/drivers/gpio.h>

void safety_init(const struct device *can_dev, const struct gpio_dt_spec *led);
void safety_kick_watchdog(void);      // heartbeat 수신 시 호출: WDT feed + 타이머 리셋 + SAFE->NORMAL 복귀
bool safety_is_safe_state(void);
```

## src/someip_sd.cpp
```c
/**
 * SOME/IP-SD 프로토콜 구현 (AUTOSAR PRS SOME/IP-SD, vsomeip 호환) - 순수 C
 *
 * Zephyr 의존 없음 -> 호스트(PC)에서 직접 컴파일/단위테스트 가능.
 * wire format 은 mpu/someip/sd.py (Python, pytest 16건 검증)와 바이트 단위 일치.
 *
 * 빅엔디안 수동 조립: Cortex-M33에서 unaligned read 를 피하기 위해
 * struct 재해석 대신 바이트 단위로 쓰고 읽는다.
 */
#include "someip_sd.h"

#include <string.h>

/* ---- 내부: 빅엔디안 쓰기/읽기 ---- */

static void put_u16(uint8_t *p, uint16_t v) {
    p[0] = (uint8_t)(v >> 8);
    p[1] = (uint8_t)v;
}

static void put_u32(uint8_t *p, uint32_t v) {
    p[0] = (uint8_t)(v >> 24);
    p[1] = (uint8_t)(v >> 16);
    p[2] = (uint8_t)(v >> 8);
    p[3] = (uint8_t)v;
}

static uint16_t get_u16(const uint8_t *p) {
    return (uint16_t)(((uint16_t)p[0] << 8) | p[1]);
}

static uint32_t get_u32(const uint8_t *p) {
    return ((uint32_t)p[0] << 24) | ((uint32_t)p[1] << 16) |
           ((uint32_t)p[2] << 8) | p[3];
}

/* ---- 내부: 서브 필드 빌더 ---- */

/* SOME/IP 헤더 16B (service 0xFFFF / method 0x8100 / SD 메시지 타입) */
static void put_someip_header(uint8_t *p, uint32_t length, uint16_t session_id) {
    put_u16(p + 0, SD_SERVICE_ID);
    put_u16(p + 2, SD_METHOD_ID);
    put_u32(p + 4, length); /* 20 + entries + options */
    put_u16(p + 8, SD_CLIENT_ID);
    put_u16(p + 10, session_id);
    p[12] = SD_PROTOCOL_VERSION;
    p[13] = SD_INTERFACE_VERSION;
    p[14] = SD_MESSAGE_TYPE;
    p[15] = SD_RETURN_CODE;
}

/* Service/Eventgroup 엔트리 16B.
 * service_entry: minor_version(4B) / eventgroup_entry: reserved(2B)+eventgroup_id(2B) */
static void put_entry(uint8_t *p, uint8_t type,
                      uint16_t service_id, uint16_t instance_id,
                      uint8_t major_version, uint32_t ttl,
                      uint16_t eventgroup_id) {
    p[0] = type;   /* index1=0, index2=0, #opts=0 (Python 기본값과 동일) */
    p[1] = 0;
    p[2] = 0;
    p[3] = 0;
    put_u16(p + 4, service_id);
    put_u16(p + 6, instance_id);
    p[8] = major_version;
    p[9] = (uint8_t)(ttl >> 16);
    p[10] = (uint8_t)(ttl >> 8);
    p[11] = (uint8_t)ttl;
    if (type == SD_ENTRY_SUBSCRIBE_EVENTGROUP ||
        type == SD_ENTRY_SUBSCRIBE_EVENTGROUP_ACK) {
        put_u16(p + 12, 0); /* reserved */
        put_u16(p + 14, eventgroup_id);
    } else {
        put_u32(p + 12, 0); /* minor_version */
    }
}

/* IPv4 Endpoint 옵션 12B (length=9, type=0x04, discardable=0) */
static void put_ip4_option(uint8_t *p, const uint8_t ip[4],
                           uint16_t port, uint8_t l4_proto) {
    put_u16(p + 0, 9);
    p[2] = SD_OPT_IP4_ENDPOINT;
    p[3] = 0; /* discardable */
    memcpy(p + 4, ip, 4);
    p[8] = 0; /* reserved */
    p[9] = l4_proto;
    put_u16(p + 10, port);
}

/* ---- 공개 빌더 ---- */

int sd_build_find_service(uint8_t *out, size_t cap,
                          uint16_t service_id, uint16_t instance_id,
                          uint16_t session_id) {
    const size_t pkt_len = 16u + 8u + SD_ENTRY_SIZE + 4u; /* 44 */
    if (cap < pkt_len || out == NULL) {
        return -1;
    }

    put_someip_header(out, 20u + SD_ENTRY_SIZE, session_id);
    out[16] = SD_FLAG_UNICAST; /* flags */
    out[17] = 0;               /* reserved 3B */
    out[18] = 0;
    out[19] = 0;
    put_u32(out + 20, SD_ENTRY_SIZE); /* entries_len = 16 */
    put_entry(out + 24, SD_ENTRY_FIND_SERVICE, service_id, instance_id,
              1, SD_TTL_DEFAULT, 0);
    put_u32(out + 40, 0); /* options_len = 0 */

    return (int)pkt_len;
}

int sd_build_subscribe_eventgroup(uint8_t *out, size_t cap,
                                  uint16_t service_id, uint16_t instance_id,
                                  uint16_t eventgroup_id,
                                  const uint8_t ip[4], uint16_t port,
                                  uint16_t session_id) {
    const size_t pkt_len = 16u + 8u + SD_ENTRY_SIZE + 4u + SD_IP4_OPTION_SIZE; /* 56 */
    if (cap < pkt_len || out == NULL || ip == NULL) {
        return -1;
    }

    put_someip_header(out, 20u + SD_ENTRY_SIZE + SD_IP4_OPTION_SIZE, session_id);
    out[16] = SD_FLAG_UNICAST;
    out[17] = 0;
    out[18] = 0;
    out[19] = 0;
    put_u32(out + 20, SD_ENTRY_SIZE);
    put_entry(out + 24, SD_ENTRY_SUBSCRIBE_EVENTGROUP, service_id, instance_id,
              1, SD_TTL_DEFAULT, eventgroup_id);
    put_u32(out + 40, SD_IP4_OPTION_SIZE); /* options_len = 12 */
    put_ip4_option(out + 44, ip, port, SD_L4_UDP);

    return (int)pkt_len;
}

/* ---- 파서 ---- */

int sd_parse(const uint8_t *buf, size_t len, struct sd_parsed *out) {
    const size_t hdr_size = 16u + 8u; /* SOME/IP + SD 헤더 */
    uint32_t entries_len, options_len, off, opt_off;
    uint8_t i;

    if (buf == NULL || out == NULL) {
        return -1;
    }
    memset(out, 0, sizeof(*out));

    if (len < hdr_size + 4u) {
        return -1;
    }
    /* SOME/IP 헤더 검증: SD 식별자 (0xFFFF / 0x8100) */
    if (get_u16(buf + 0) != SD_SERVICE_ID || get_u16(buf + 2) != SD_METHOD_ID) {
        return -1;
    }

    entries_len = get_u32(buf + 20);
    if (entries_len % SD_ENTRY_SIZE != 0 || entries_len / SD_ENTRY_SIZE > SD_MAX_ENTRIES) {
        return -1;
    }
    if (hdr_size + entries_len + 4u > len) {
        return -1; /* options_len 필드까지 필요 */
    }
    options_len = get_u32(buf + hdr_size + entries_len);
    if (options_len > len - (hdr_size + entries_len + 4u)) {
        return -1;
    }

    out->flags = buf[16];
    out->session_id = get_u16(buf + 10);
    out->entry_count = (uint8_t)(entries_len / SD_ENTRY_SIZE);

    /* entries 파싱 */
    for (off = 0; off < entries_len; off += SD_ENTRY_SIZE) {
        const uint8_t *e = buf + hdr_size + off;
        struct sd_entry *d = &out->entries[off / SD_ENTRY_SIZE];

        d->type = e[0];
        d->service_id = get_u16(e + 4);
        d->instance_id = get_u16(e + 6);
        d->major_version = e[8];
        d->ttl = ((uint32_t)e[9] << 16) | ((uint32_t)e[10] << 8) | e[11];
        if (d->type == SD_ENTRY_SUBSCRIBE_EVENTGROUP ||
            d->type == SD_ENTRY_SUBSCRIBE_EVENTGROUP_ACK) {
            d->eventgroup_id = get_u16(e + 14);
        }
    }

    /* options 파싱 (연속 배치, 블록 크기 = 3 + length) */
    opt_off = 0;
    for (i = 0; i < SD_MAX_OPTIONS && opt_off + 3u <= options_len; i++) {
        const uint8_t *o = buf + hdr_size + entries_len + 4u + opt_off;
        uint32_t block = 3u + get_u16(o + 0);
        if (block > options_len - opt_off) {
            break;
        }
        if (o[2] == SD_OPT_IP4_ENDPOINT && block >= SD_IP4_OPTION_SIZE) {
            struct sd_option_ip4 *d = &out->options[i];
            d->type = o[2];
            memcpy(d->address, o + 4, 4);
            d->l4_proto = o[9];
            d->port = get_u16(o + 10);
            out->option_count = i + 1;
        }
        opt_off += block;
    }

    return 0;
}
```

## src/someip_sd.h
```c
/**
 * SOME/IP-SD 프로토콜 (AUTOSAR PRS SOME/IP-SD, vsomeip 호환) - 순수 C 모듈
 *
 * Zephyr에 의존하지 않으므로 호스트에서 clang++/g++로 직접 컴파일 가능
 * (MCU/tests/test_someip_sd_host.cpp 가 wire format 을 검증).
 *
 * 와이어 포맷 (모두 빅엔디안):
 *   SOME/IP 헤더 16B: service 0xFFFF | method 0x8100 | length u32 |
 *                     client u16 | session u16 | 01 01 02 00
 *   SD 헤더 8B:       flags u8 | reserved 3B | entries_len u32
 *   entries (16B 단위) | options_len u32 | options
 *   length = 20 + len(entries) + len(options)
 */
#pragma once

#include <stddef.h>
#include <stdint.h>

#define SD_SERVICE_ID 0xFFFF
#define SD_METHOD_ID 0x8100
#define SD_CLIENT_ID 0x0000
#define SD_PROTOCOL_VERSION 0x01
#define SD_INTERFACE_VERSION 0x01
#define SD_MESSAGE_TYPE 0x02
#define SD_RETURN_CODE 0x00
#define SD_FLAG_UNICAST 0x40

#define SD_ENTRY_FIND_SERVICE 0x00
#define SD_ENTRY_OFFER_SERVICE 0x01
#define SD_ENTRY_SUBSCRIBE_EVENTGROUP 0x06
#define SD_ENTRY_SUBSCRIBE_EVENTGROUP_ACK 0x07

#define SD_OPT_IP4_ENDPOINT 0x04
#define SD_L4_UDP 0x11
#define SD_TTL_DEFAULT 0xFFFFFF

#define SD_ENTRY_SIZE 16u
#define SD_IP4_OPTION_SIZE 12u
#define SD_MAX_ENTRIES 4u
#define SD_MAX_OPTIONS 4u

struct sd_entry {
    uint8_t type;
    uint16_t service_id;
    uint16_t instance_id;
    uint8_t major_version;
    uint32_t ttl;             /* 24-bit TTL */
    uint16_t eventgroup_id;   /* eventgroup 엔트리 전용 (서비스 엔트리는 0) */
};

struct sd_option_ip4 {
    uint8_t type;
    uint8_t address[4];
    uint8_t l4_proto;
    uint16_t port;
};

struct sd_parsed {
    uint8_t flags;
    uint16_t session_id;
    uint8_t entry_count;
    struct sd_entry entries[SD_MAX_ENTRIES];
    uint8_t option_count;
    struct sd_option_ip4 options[SD_MAX_OPTIONS];
};

/**
 * FindService 패킷 빌드: ENTRY_FIND_SERVICE 1개, 옵션 없음 (멀티캐스트 전송용).
 * @return 패킷 길이(44) 또는 -1 (버퍼 부족)
 */
int sd_build_find_service(uint8_t *out, size_t cap,
                          uint16_t service_id, uint16_t instance_id,
                          uint16_t session_id);

/**
 * SubscribeEventgroup 패킷 빌드: ENTRY_SUBSCRIBE_EVENTGROUP 1개 + IPv4 Endpoint 옵션 1개.
 * @return 패킷 길이(56) 또는 -1 (버퍼 부족)
 */
int sd_build_subscribe_eventgroup(uint8_t *out, size_t cap,
                                  uint16_t service_id, uint16_t instance_id,
                                  uint16_t eventgroup_id,
                                  const uint8_t ip[4], uint16_t port,
                                  uint16_t session_id);

/**
 * SD 패킷 파서. entries/options 배열에 담아 반환.
 * @return 0 성공 / -1 형식 오류 (헤더 불일치, 길이 오류 등)
 */
int sd_parse(const uint8_t *buf, size_t len, struct sd_parsed *out);
```

## src/someip_service.cpp
```c
/**
 * SOME/IP Light Stack - Zephyr 구현
 *
 * 설계: App Lab Bridge (proprietary)를 vsomeip 호환 SOME/IP로 재구현
 * - Service: DriverMonitoringService 0x1234 / Instance 0x5678
 * - Event: NotifyDrowsiness (0x8001), Heartbeat (0x8002)
 * - Transport: UDP unicast 30490 (기본, PC 시뮬레이션) / UART tunnel (실보드)
 *
 * 실제 vsomeip는 Linux용이라 Zephyr에서는 경량 SOME/IP 파서 구현.
 * 패킷 포맷은 vsomeip와 호환 - Wireshark에서 SOME/IP로 인식됨.
 *
 * SOME/IP 헤더 16바이트 (빅엔디안):
 *   service_id u16 | method_id u16 | length u32 | client_id u16 | session_id u16 |
 *   protocol_version u8 | interface_version u8 | message_type u8 | return_code u8
 *   length = payload 길이 + 8 (1바이트 payload면 length=9)
 *   UDP 데이터그램은 8바이트 정렬: 16헤더 + 1payload = 17 -> +7 패딩 = 총 24 (패딩은 length에 미포함)
 */

#include "someip_service.h"
#include "someip_sd.h" /* SD 프로토콜: 상수/빌더/파서 (순수 C, 호스트 테스트 대상) */
#include <zephyr/kernel.h>
#include <zephyr/device.h>
#include <zephyr/devicetree.h>
#include <zephyr/net/net_ip.h> /* net_ntohl/net_ntohs, net_addr_ntop (Zephyr main) */
#include <zephyr/sys/byteorder.h>
#include <zephyr/logging/log.h>
LOG_MODULE_REGISTER(someip, LOG_LEVEL_INF);

#define SOMEIP_PORT 30490
#define SERVICE_ID 0x1234
#define INSTANCE_ID 0x5678
#define EVENT_NOTIFY 0x8001
#define EVENT_HEARTBEAT 0x8002
#define SD_EVENTGROUP_ID 0x0001 /* Notify/Heartbeat 이벤트 그룹 (구독 대상) */

// SD 멀티캐스트 전송/수신 주소 (일부만 someip_sd.h에 없어 여기 유지)
#define SD_MULTICAST_IP "224.224.224.245"
#define SD_MULTICAST_ADDR 0xE0E0E0F5 /* 224.224.224.245 (네트워크 오더 변환 전) */

// SOME/IP Header (AUTOSAR SWS, 16 bytes) - 네트워크(빅엔디안) 바이트 오더
struct someip_header {
    uint16_t service_id;
    uint16_t method_id; // Event ID (0x8001 / 0x8002)
    uint32_t length;    // payload + 8
    uint16_t client_id;
    uint16_t session_id;
    uint8_t protocol_version;
    uint8_t interface_version;
    uint8_t message_type; // 0x02 = Notification
    uint8_t return_code;
} __attribute__((packed));

#ifndef CONFIG_SOMEIP_TRANSPORT_UART
#include <zephyr/net/socket.h>
static int sock = -1;
#endif

#ifdef CONFIG_SOMEIP_TRANSPORT_UART
#define SOMEIP_UART_NODE DT_ALIAS(someip-uart)
static const struct device *uart_dev = DEVICE_DT_GET(SOMEIP_UART_NODE);
static uint8_t rx_buf[64];
static size_t rx_len = 0;
static int64_t last_rx_tick = 0;

/**
 * UART RX 상태 머신: 바이트 스트림에서 SOME/IP 프레임 재조립.
 * 1) 16바이트 헤더 확보 -> 2) header.length 필드로 payload 길이 계산
 *    (전체 프레임 = 16 + (length - 8)) -> 3) 완전 프레임 수신 시 파싱/반환.
 * 불완전 프레임 상태로 50ms 이상 데이터가 없으면 버퍼 리셋 (스트림 재동기).
 */
static int someip_uart_receive(uint16_t *event_id, uint8_t *payload) {
    while (1) {
        // 스트림 재동기: 불완전 프레임 50ms 데이터 부재 시 리셋
        if (rx_len > 0 && (k_uptime_get() - last_rx_tick) > 50) {
            LOG_WRN("SOME/IP UART: partial frame (%u B) timeout -> resync",
                    (unsigned)rx_len);
            rx_len = 0;
        }

        uint8_t byte;
        while (uart_poll_in(uart_dev, &byte) == 0) {
            last_rx_tick = k_uptime_get();
            if (rx_len >= sizeof(rx_buf)) {
                rx_len = 0; // 버퍼 오버플로우 -> 재동기
                continue;
            }
            rx_buf[rx_len++] = byte;

            if (rx_len >= sizeof(struct someip_header)) {
                auto *hdr = reinterpret_cast<struct someip_header *>(rx_buf);
                uint32_t length = net_ntohl(hdr->length);
                if (length < 8 || length > 32) {
                    LOG_WRN("SOME/IP UART: invalid length %u -> resync", length);
                    rx_len = 0;
                    continue;
                }
                size_t total = sizeof(struct someip_header) + (length - 8);
                if (rx_len >= total) {
                    // 완전 프레임 수신 -> 공통 검증 (service_id/message_type/length)
                    if (net_ntohs(hdr->service_id) == SERVICE_ID &&
                        hdr->message_type == 0x02) {
                        *event_id = net_ntohs(hdr->method_id);
                        *payload = rx_buf[sizeof(struct someip_header)];
                        rx_len = 0;
                        return 0;
                    }
                    LOG_WRN("SOME/IP UART: invalid frame (svc 0x%04X type %u) -> skip",
                            net_ntohs(hdr->service_id), hdr->message_type);
                    rx_len = 0;
                }
            }
        }
        k_sleep(K_MSEC(10));
    }
}
#endif

int someip_init(void) {
#ifdef CONFIG_SOMEIP_TRANSPORT_UART
    // UART 전송 (실보드: UNO Q LPUART1 터널). 115200은 보드 기본 설정 사용.
    if (!device_is_ready(uart_dev)) {
        LOG_ERR("SOME/IP UART device not ready (DT_ALIAS someip-uart)");
        return -1;
    }
    LOG_INF("SOME/IP transport: UART (%s, 115200)", uart_dev->name);
    return 0;
#else
    // UDP socket for SOME/IP (PC 시뮬레이션: 127.0.0.1:30490)
    sock = zsock_socket(AF_INET, SOCK_DGRAM, IPPROTO_UDP);
    if (sock < 0) {
        LOG_ERR("SOME/IP socket failed: %d", sock);
        return -1;
    }
    struct sockaddr_in addr = {0};
    addr.sin_family = AF_INET;
    addr.sin_port = htons(SOMEIP_PORT);
    addr.sin_addr.s_addr = htonl(INADDR_ANY);
    if (zsock_bind(sock, reinterpret_cast<struct sockaddr *>(&addr), sizeof(addr)) < 0) {
        LOG_ERR("SOME/IP bind failed");
        return -1;
    }
    // SD(Service Discovery) 수신: OfferService가 멀티캐스트 224.224.224.245:30490으로
    // 오므로 멀티캐스트 그룹에 join한다. (vsomeip와 동일 포트, 동일 소켓에서 구분 수신)
    struct ip_mreq mreq = {0};
    mreq.imr_multiaddr.s_addr = htonl(SD_MULTICAST_ADDR);
    mreq.imr_interface.s_addr = htonl(INADDR_ANY);
    if (zsock_setsockopt(sock, IPPROTO_IP, IP_ADD_MEMBERSHIP, &mreq, sizeof(mreq)) < 0) {
        LOG_WRN("SOME/IP SD multicast join failed (OfferService 수신 불가)");
    } else {
        LOG_INF("SOME/IP SD multicast joined: %s:%d", SD_MULTICAST_IP, SOMEIP_PORT);
    }
    LOG_INF("SOME/IP listening on UDP %d (Service 0x%04X)", SOMEIP_PORT, SERVICE_ID);
    return 0;
#endif
}

int someip_offer_service(void) {
    // MCU는 소비자(Consumer) 역할: 주기적 multicast OfferService 광고는 하지 않고,
    // someip_sd_send_find()로 서비스를 탐색하고, OfferService 수신 시
    // someip_sd_send_subscribe()로 이벤트그룹을 구독한다 (SD 클라이언트 흐름).
    LOG_INF("SOME/IP OfferService: 0x%04X/0x%04X Events 0x%04X/0x%04X (SD client)",
            SERVICE_ID, INSTANCE_ID, EVENT_NOTIFY, EVENT_HEARTBEAT);
    return 0;
}

#ifndef CONFIG_SOMEIP_TRANSPORT_UART

/**
 * SD(Service Discovery) 메시지 수신 처리.
 *
 * 파싱은 someip_sd.h의 sd_parse() (순수 C, 호스트 테스트로 wire format 검증됨)에 위임.
 *
 * OfferService(0x01) 수신 시 우리 서비스(0x1234/0x5678)를 찾아
 * IPv4 Endpoint 옵션(0x04)에서 프로바이더 주소를 로그로 남기고,
 * SubscribeEventgroup(0x06) 수신 시 이벤트그룹 구독 요청을 로그로 남긴다.
 * SD 메시지는 이벤트가 아니므로 항상 -1을 반환한다 (이벤트 처리 생략).
 */
static int someip_sd_handle(const uint8_t *buf, ssize_t len) {
    struct sd_parsed parsed;
    if (sd_parse(buf, (size_t)len, &parsed) < 0) {
        return -1;
    }

    for (uint8_t i = 0; i < parsed.entry_count; i++) {
        const struct sd_entry *e = &parsed.entries[i];

        if (e->type == SD_ENTRY_OFFER_SERVICE) {
            if (e->ttl == 0) {
                LOG_INF("SOME/IP SD: StopOffer 0x%04X/0x%04X",
                        e->service_id, e->instance_id);
                continue;
            }
            if (e->service_id != SERVICE_ID || e->instance_id != INSTANCE_ID) {
                continue;
            }
            // OfferService의 첫 IPv4 Endpoint 옵션에서 프로바이더 주소 추출
            for (uint8_t j = 0; j < parsed.option_count; j++) {
                const struct sd_option_ip4 *o = &parsed.options[j];
                if (o->type == SD_OPT_IP4_ENDPOINT && o->l4_proto == SD_L4_UDP) {
                    char ip_str[NET_IPV4_ADDR_LEN];
                    net_addr_ntop(AF_INET, o->address, ip_str, sizeof(ip_str));
                    LOG_INF("SOME/IP SD: OfferService 0x%04X/0x%04X @ %s:%u (major %u)",
                            e->service_id, e->instance_id, ip_str, o->port,
                            e->major_version);
                    // 소비자 흐름 완성: Find -> Offer 수신 -> Subscribe 전송
                    someip_sd_send_subscribe();
                    break;
                }
            }
        } else if (e->type == SD_ENTRY_SUBSCRIBE_EVENTGROUP) {
            LOG_INF("SOME/IP SD: SubscribeEventgroup 0x%04X/0x%04X eg 0x%04X (major %u)",
                    e->service_id, e->instance_id, e->eventgroup_id,
                    e->major_version);
        }
    }
    return -1; // SD 메시지는 이벤트 아님
}

/**
 * FindService 전송: 멀티캐스트 224.224.224.245:30490으로 서비스 탐색 요청.
 * (소비자 역할 - vsomeip 호환 SD 클라이언트)
 */
int someip_sd_send_find(void) {
    uint8_t buf[64];
    static uint16_t session_id = 0;
    int pkt_len = sd_build_find_service(buf, sizeof(buf), SERVICE_ID, INSTANCE_ID,
                                        ++session_id);
    if (pkt_len < 0) {
        LOG_WRN("SOME/IP SD: FindService build failed");
        return -1;
    }
    struct sockaddr_in dst = {0};
    dst.sin_family = AF_INET;
    dst.sin_port = htons(SOMEIP_PORT);
    dst.sin_addr.s_addr = htonl(SD_MULTICAST_ADDR);
    int ret = zsock_sendto(sock, buf, (size_t)pkt_len, 0,
                           reinterpret_cast<struct sockaddr *>(&dst), sizeof(dst));
    if (ret == pkt_len) {
        LOG_INF("SOME/IP SD: FindService 0x%04X/0x%04X sent (session %u)",
                SERVICE_ID, INSTANCE_ID, session_id);
        return 0;
    }
    LOG_WRN("SOME/IP SD: FindService send failed (%d)", ret);
    return -1;
}

/**
 * SubscribeEventgroup 전송: 이벤트그룹 0x0001 구독 요청 (프로바이더 유니캐스트).
 * 소비자 역할 완성: Find -> Offer 수신 -> Subscribe.
 */
int someip_sd_send_subscribe(void) {
    uint8_t buf[64];
    static uint16_t session_id = 0;
    // 구독 요청자의 수신 엔드포인트 = 로컬 (UDP 30490). PC 시뮬레이션 기준.
    const uint8_t self_ip[4] = {127, 0, 0, 1};
    int pkt_len = sd_build_subscribe_eventgroup(
        buf, sizeof(buf), SERVICE_ID, INSTANCE_ID, SD_EVENTGROUP_ID,
        self_ip, SOMEIP_PORT, ++session_id);
    if (pkt_len < 0) {
        LOG_WRN("SOME/IP SD: SubscribeEventgroup build failed");
        return -1;
    }
    struct sockaddr_in dst = {0};
    dst.sin_family = AF_INET;
    dst.sin_port = htons(SOMEIP_PORT);
    dst.sin_addr.s_addr = htonl(0x7F000001); // 127.0.0.1 = INADDR_LOOPBACK (Zephyr는 상수 미제공), 프로바이더 = MPU (PC 시뮬레이션)
    int ret = zsock_sendto(sock, buf, (size_t)pkt_len, 0,
                           reinterpret_cast<struct sockaddr *>(&dst), sizeof(dst));
    if (ret == pkt_len) {
        LOG_INF("SOME/IP SD: SubscribeEventgroup eg 0x%04X sent (session %u)",
                SD_EVENTGROUP_ID, session_id);
        return 0;
    }
    LOG_WRN("SOME/IP SD: SubscribeEventgroup send failed (%d)", ret);
    return -1;
}

static int someip_udp_receive(uint16_t *event_id, uint8_t *payload) {
    uint8_t buf[64];
    struct sockaddr_in src;
    socklen_t len = sizeof(src);
    // Non-blocking with timeout 50ms
    struct timeval tv = {.tv_sec = 0, .tv_usec = 50000};
    zsock_setsockopt(sock, SOL_SOCKET, SO_RCVTIMEO, &tv, sizeof(tv));

    int ret = zsock_recvfrom(sock, buf, sizeof(buf), 0, reinterpret_cast<struct sockaddr *>(&src), &len);
    if (ret < (int)sizeof(struct someip_header) + 1) return -1;

    auto *hdr = reinterpret_cast<struct someip_header *>(buf);
    // SD(Service Discovery) 메시지 라우팅: service 0xFFFF는 이벤트가 아니므로 별도 처리
    if (net_ntohs(hdr->service_id) == SD_SERVICE_ID) {
        return someip_sd_handle(buf, ret);
    }

    // 공통 검증: service_id==0x1234 && message_type==0x02 && length sanity (>=8 && <=32)
    uint32_t length = net_ntohl(hdr->length);
    if (net_ntohs(hdr->service_id) != SERVICE_ID) return -1;
    if (hdr->message_type != 0x02) return -1;
    if (length < 8 || length > 32) return -1;

    *event_id = net_ntohs(hdr->method_id); // 호스트 바이트 오더
    *payload = buf[sizeof(struct someip_header)]; // payload 첫 바이트
    char src_str[NET_IPV4_ADDR_LEN];
    net_addr_ntop(AF_INET, &src.sin_addr, src_str, sizeof(src_str));
    LOG_DBG("SOME/IP Notify RX: event=0x%04X level=%d from %s",
            *event_id, *payload, src_str);
    return 0;
}
#endif

// UART/UDP 공통 진입점
int someip_receive(uint16_t *event_id, uint8_t *payload) {
#ifdef CONFIG_SOMEIP_TRANSPORT_UART
    return someip_uart_receive(event_id, payload);
#else
    return someip_udp_receive(event_id, payload);
#endif
}

#ifdef CONFIG_SOMEIP_TRANSPORT_UART
/* SD 발신은 UDP 멀티캐스트 전용 (PC 시뮬레이션). 실보드(UART 터널)에서는 미지원.
 * 헤더 선언과 링크를 맞추기 위한 스텁. */
int someip_sd_send_find(void) {
    LOG_INF("SOME/IP SD: FindService over UART not supported");
    return -1;
}

int someip_sd_send_subscribe(void) {
    LOG_INF("SOME/IP SD: SubscribeEventgroup over UART not supported");
    return -1;
}
#endif
```

## src/someip_service.h
```c
#pragma once
#include <stdint.h>

// SOME/IP Light Stack for Zephyr (vsomeip-compatible)
// Service: DriverMonitoringService 0x1234, Instance 0x5678, Event 0x8001 (NotifyDrowsiness)
// Transport: UDP unicast 30490 (PC simulation) / UART tunnel (real board, CONFIG_SOMEIP_TRANSPORT_UART=y)

int someip_init(void);
int someip_offer_service(void);          // 정보용 로그 (SD 수신/발신 클라이언트 역할 명시)
int someip_receive(uint16_t *event_id, uint8_t *payload); // 성공 0, 실패/타임아웃 -1
int someip_sd_send_find(void);           // FindService 멀티캐스트 전송 (소비자 탐색)
int someip_sd_send_subscribe(void);      // SubscribeEventgroup 전송 (이벤트그룹 구독)
```
