## yocto/build/conf/bblayers.conf
```bitbake
# POKY_BBLAYERS_CONF_VERSION is increased each time build/conf/bblayers.conf
# changes incompatibly
POKY_BBLAYERS_CONF_VERSION = "2"

BBPATH = "${TOPDIR}"
BBFILES ?= ""

BBLAYERS ?= " \
  /home/yocto/yocto/poky/meta \
  /home/yocto/yocto/poky/meta-poky \
  /home/yocto/yocto/poky/meta-yocto-bsp \
  "

# SDV custom layer
BBLAYERS += " ${TOPDIR}/../meta-sdv "
BBLAYERS += " ${TOPDIR}/../meta-openembedded/meta-oe "
BBLAYERS += " ${TOPDIR}/../meta-openembedded/meta-networking "
BBLAYERS += " ${TOPDIR}/../meta-openembedded/meta-python "
BBLAYERS += " ${TOPDIR}/../meta-virtualization "
BBLAYERS += " ${TOPDIR}/../meta-openembedded/meta-filesystems "
```
